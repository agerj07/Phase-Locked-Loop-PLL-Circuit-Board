

#include<Wire.h>

#define EEPROM_ADDRESS 0x50   //I2C for eeprom


byte nackStat;    //returns the I2C communication status(0 means no issue)
int input = 0;    //determines 8khz vs 12khz
unsigned int divider;   //output divider value
byte divReg1;     //temporary register storing output divider uint
byte divReg2;
byte divReg3;
byte divReg4;

//settings for 8Khz input signal
byte Eight[] = {0x05, 0x20, 0x01, 0x02, 0x56, 0x04, 0x03, 0x20, 0x00, 0x00, 0x00, 0x00, 0x00, 0x1A, 0x00, 0x01, 0x00, 0x00, 0x00, 0x00, 0x00,
0x00, 0x00, 0x00, 0x00, 0x00, 0x00, 0x00, 0x00, 0x00, 0x00, 0x00, 0x00, 0x00, 0x00, 0x00, 0x00, 0x00, 0x00, 0x00, 0x00, 0x00, 0x00, 0x09, 0x00,
0x02, 0x17, 0x09, 0x00, 0x08, 0x71, 0x1B, 0x0C, 0x32, 0x00, 0x00, 0x80, 0x91, 0x1C, 0x80, 0x02, 0x00, 0x00, 0x00, 0x00, 0x00, 0x00, 0x00, 0x00,
0x00, 0x00, 0x00, 0x00, 0x00, 0x00, 0x00, 0x00, 0x00, 0x00, 0x00, 0x00, 0x00, 0x00, 0x00, 0x00, 0x00, 0x00, 0x00, 0x00, 0x00, 0x07, 0x00, 0x03,
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0xFF, 0xFF, 0xFF, 0xFF, 0xFF, 0xFF, 0xFF, 0xFF, 0xFF, 0xFF, 0xFF};

//settings for 12khz signal
byte Twelve[] = {0x05, 0x21, 0x01, 0x02, 0x56, 0x04, 0x03, 0x20, 0x00, 0x00, 0x00, 0x00, 0x00, 0x1A, 0x00, 0x01, 0x00, 0x00, 0x00, 0x00, 0x00,
0x00, 0x00, 0x00, 0x00, 0x00, 0x00, 0x00, 0x00, 0x00, 0x00, 0x00, 0x00, 0x00, 0x00, 0x00, 0x00, 0x00, 0x00, 0x00, 0x00, 0x00, 0x00, 0x09, 0x00,
0x02, 0x17, 0x09, 0x00, 0x08, 0x71, 0x1B, 0x0C, 0x32, 0x00, 0x00, 0x80, 0x91, 0x1C, 0x80, 0x02, 0x00, 0x00, 0x00, 0x00, 0x00, 0x00, 0x00, 0x00,
0x00, 0x00, 0x00, 0x00, 0x00, 0x00, 0x00, 0x00, 0x00, 0x00, 0x00, 0x00, 0x00, 0x00, 0x00, 0x00, 0x00, 0x00, 0x00, 0x00, 0x00, 0x07, 0x00, 0x03,
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0xFF, 0xFF, 0xFF, 0xFF, 0xFF, 0xFF, 0xFF, 0xFF, 0xFF, 0xFF, 0xFF};

                          








//0D or divider we want to change is settings[805]

//in ace software the divider is controlled by the register 1512, 1513, 1514 and 1515.
//msb goes into the higher registers with the max being 0xFFFFFFFF which is 4294967295 in decimal.
//need to get the users int divider value, convert that value to a hex value and then store in appropriate registers.






void printBin(byte aByte) {   //function to print binary
  for (int8_t aBit = 7; aBit >= 0; aBit--)
    Serial.print(bitRead(aByte, aBit) ? '1' : '0');
}


void writeEEPROM(byte control, byte dataAdd, byte data){    //writes to the eeprom
  //blockSelect = dataAdd & (0b11100000);
  //blockSelect = blockSelect >> 4;
  //control |= blockSelect;

  byte highAdd;
  byte lowAdd;

  highAdd = (dataAdd >> 8) & 0xFF;
  lowAdd = dataAdd & 0xFF;
    
  Serial.print("Control byte: ");
  printBin(control);
  Serial.print(". Data address: ");
  printBin(dataAdd);
  Serial.print(". Setting write: ");
  Serial.print(data,HEX);
    
  Wire.beginTransmission(EEPROM_ADDRESS);
  Wire.write(control);
  Wire.write(highAdd);
  Wire.write(lowAdd);
  Wire.write(data);
  byte transmissionStatus = Wire.endTransmission();
    
  Serial.print(". Write status: ");   //checks the status of the write
  Serial.println(transmissionStatus);
  delay(10);
}


void readEEPROM(byte Control, byte dataAdd){    //read the eeprom register just written to (current read)
  
  
  
  Wire.beginTransmission(EEPROM_ADDRESS);
  Wire.write(Control);

  byte nackStat = Wire.endTransmission(false); //keep the connection active for reading
  Serial.print("Read control byte. Status: ");
  Serial.println(nackStat);

  if(nackStat == 0){
      Wire.requestFrom(EEPROM_ADDRESS, 1); //request one byte from EEPROM
      
      while(Wire.available()){
      
        byte dataRead = Wire.read(); //read the received byte
        Serial.print("Data read at address 0x");
        Serial.print(dataAdd, HEX);
        Serial.print(". Value: ");
        Serial.println(dataRead, HEX);
      }
      nackStat = Wire.endTransmission();
  
      delay(10);
  }  
}

void inputFreq(void){    //decide wanted input frequency
  char answer = '\0';
  while(Serial.available() > 0){
      char c = Serial.read();
  }
  
  Serial.println("Enter 'a' for 7.919Khz input freq");
  Serial.println("Enter 'b' for 12Khz input freq");
  
  while (!Serial.available()){
    delay(10);
  }
  answer = Serial.read();
  Serial.println(answer);

  while (!(answer == 'a' || answer == 'b' || answer == 'A' || answer == 'B')) {
    Serial.println("Incorrect Response");
    while (!Serial.available()){}
    answer = Serial.read();
  }

  if(answer == 'a' || answer == 'A') {
    input = 1;
    while(Serial.available() > 0){
      char c = Serial.read();
    }
  
  }else if(answer == 'b' || answer == 'B') {
      input = 2;
      while(Serial.available() > 0){
        char c = Serial.read();
      }
    }
}

void outputDiv(){   //decide wanted output divider/multiplier
  char answer;
  Serial.setTimeout(5000);    //for parseInt function
  
  Serial.println("Do you want to change the output divider? (y/n)");
  while(!Serial.available()) {}
  answer = Serial.read();
  while(Serial.available() > 0) {
      char c = Serial.read();
  }
  if(answer == 'y' || answer == 'Y') {
    Serial.println("Enter desired divider value: ");
    
    while(Serial.available() == 0){}
    while(Serial.available() > 0){
      divider = Serial.parseInt();    //read integer
      while(!divider){}  
      
      //delay(750);
      Serial.println(divider);
      
      //take the input and place in temporary registers
      divReg1 = divider & 0xFF;
      divReg2 = (divider >> 8) & 0xFF;
      divReg3 = (divider >> 16) & 0xFF;
      divReg4 = divider >> 24;
    
      
    }  
  }
  else{
    Serial.println("Output Frequency not changed");
  }

    // Clear any remaining characters in the input buffer
    while(Serial.available() > 0) {
      char c = Serial.read();
    }
  
}







void setup() {
  Serial.begin(9600);
  while(!Serial){
    Serial.println("Waiting for serial..."); 
  }
  Wire.begin();
  delay(1000);
  byte controlByteWrite = 0b10100000; // Control byte for write operation
  byte controlByteRead = 0b10100001;  //Control byte for read operation
  byte blockSelectBits = 0b000; 
  byte dataAddress = 0x00; // Address of the memory location to write


  outputDiv();    //see if want to change output divider
  delay(1000);
  inputFreq();    //select input freq
  Serial.println(input);
  delay(1000);
  int i = 0;
  if(input == 1){   //7.7919Khz case
    
    Eight[805] = divReg1;     //display output divider registers
    Eight[806] = divReg2;
    Eight[807] = divReg3;
    Eight[808] = divReg4;

    Serial.print("divReg1: ");
    printBin(divReg1);
    Serial.println();
    Serial.print("divReg2: ");
    printBin(divReg2);
    Serial.println();
    Serial.print("divReg3: ");
    printBin(divReg3);
    Serial.println();
    Serial.print("divReg4: ");
    printBin(divReg4);
    Serial.println();
    
    for (i = 0; i < 1280; i++){   //write and read all 1280 bytes to eeprom
    
     // writeEEPROM(controlByteWrite, dataAddress, Eight[i]);
      readEEPROM(controlByteRead, dataAddress);
      dataAddress++;
      if((dataAddress % 256) == 0 ){
        dataAddress = 0x00;
      }
      if(i == 255){
        controlByteWrite = 0b10100010;
        controlByteRead = 0b10100011;
      }
      else if(i == 511){
        controlByteWrite = 0b10100100;
        controlByteRead = 0b10100101;  
      }
      else if(i == 767){
        controlByteWrite = 0b10100110;
        controlByteRead = 0b10100111;
      }
      else if(i == 1023){
        controlByteWrite = 0b10101000;
        controlByteRead = 0b10101001;
      }
    
    }
  }
  else if(input == 2){    //12Khz case

    
    Serial.print("divReg1: ");
    printBin(divReg1);
    Serial.println();
    Serial.print("divReg2: ");
    printBin(divReg2);
    Serial.println();
    Serial.print("divReg3: ");
    printBin(divReg3);
    Serial.println();
    Serial.print("divReg4: ");
    printBin(divReg4);
    Serial.println();
    
    Twelve[805] = divReg1;
    Twelve[806] = divReg2;
    Twelve[807] = divReg3;
    Twelve[808] = divReg4;
    
    for (i = 0; i < 1280; i++){
      
     // writeEEPROM(controlByteWrite, dataAddress, Twelve[i]);
      readEEPROM(controlByteRead, dataAddress);
      dataAddress++;
      if((dataAddress % 256) == 0 ){
        dataAddress = 0x00;
      }
      if(i == 255){
        controlByteWrite = 0b10100010;
        controlByteRead = 0b10100011;
      }
      else if(i == 511){
        controlByteWrite = 0b10100100;
        controlByteRead = 0b10100101;  
      }
      else if(i == 767){
        controlByteWrite = 0b10100110;
        controlByteRead = 0b10100111;
      }
      else if(i == 1023){
        controlByteWrite = 0b10101000;
        controlByteRead = 0b10101001;
      }
      
    }
  }
  
 
  
  
}



void loop() {


}
